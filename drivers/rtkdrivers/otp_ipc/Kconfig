## drivers/rtkdrivers/otp_ipc/Kconfig
```kconfig
config OTP_IPC_RTK_AMEBA_CDEV
	tristate "OTP IPC control driver"
	help
		This enables the OTP IPC for userspace.
```

## drivers/rtkdrivers/pinctrl/Kconfig
```kconfig
# SPDX-License-Identifier: GPL-2.0

config PINCTRL_RTK_AMEBA
	bool "Pinctrl driver"
	select PINMUX
	select GENERIC_PINCONF
	select GPIOLIB
	select PINCONF
	select OF_GPIO
	select GPIOLIB_IRQCHIP
	default y
```

## drivers/rtkdrivers/pwm/Kconfig
```kconfig
# SPDX-License-Identifier: GPL-2.0-only

config PWM_RTK_AMEBA
	tristate "PWM driver"
	select PWM
	select MFD_RTK_AMEBA_TIMERS
	help
	  Generic PWM driver for Realtek pwm timer.
```

## drivers/rtkdrivers/rtc/Kconfig
```kconfig
# SPDX-License-Identifier: GPL-2.0-only

config RTC_RTK_AMEBA
        tristate "RTC driver"
		select RTC_CLASS
		select RTC_INTF_SYSFS
		select RTC_INTF_PROC
		select RTC_INTF_DEV
        help
          Choose yes to support Real Time Clock driver for Realtek Ameba SoCs.
```

## drivers/rtkdrivers/spi/Kconfig
```kconfig
config SPI_RTK_AMEBA
	tristate "SPI general controller driver"
	select HAS_IOMEM
	select SPI
	select SPI_SLAVE
	help
	  This is the driver for Realtek SPI Controller.
	  If SPI in Userspace is needed, please select SPI_SPIDEV manually, and set rtk,spi-default-cs(dts) to <0>.
	  If FBTFT-SPI is needed, please confirm SPI_SPIDEV is closed, and set rtk,spi-default-cs(dts) to <1>.
	  If SPI Slave mode is needed, please select SPI_SLAVE mannally and set rtk,spi-slave-mode(dts) to <1>.
```

## drivers/rtkdrivers/thermal/Kconfig
```kconfig
# SPDX-License-Identifier: GPL-2.0-only
config THERMAL_RTK_AMEBA
	tristate "Thermal driver"
	select THERMAL
	help
	  Support for Realtek thermal framework. This thermal driver allows
	  to access to general thermal framework functionalities and to acces
	  to SoC sensor functionalities.
```

## drivers/rtkdrivers/tty_serial/Kconfig
```kconfig
# SPDX-License-Identifier: GPL-2.0

menuconfig SERIAL_RTK_AMEBA
	tristate "UART driver"
	select TTY
	select SERIAL_CORE
	help
		This enables the driver for the onchip UART core for Ameba

if SERIAL_RTK_AMEBA

config SERIAL_RTK_AMEBA_CONSOLE
	bool "Console on AMEBA serial port"
	depends on SERIAL_RTK_AMEBA=y
	select SERIAL_CORE_CONSOLE
	select SERIAL_EARLYCON
	help
		If you have enabled the serial port on the AMEBA CPU
		you can make it the console by answering Y to this option.

config SERIAL_RTK_AMEBA_GENERIC
	bool "General UART driver"
	depends on SERIAL_RTK_AMEBA=y
	help
		Ameba general tty serial driver.

endif
```

## drivers/rtkdrivers/watchdog/Kconfig
```kconfig
config WATCHDOG_RTK_AMEBA
	tristate "Watchdog driver"
	select WATCHDOG
	select WATCHDOG_CORE
	help
	  Support for the watchdog on realtek ameba device.
```

## sound/soc/realtek/Kconfig
```kconfig
# SPDX-License-Identifier: GPL-2.0-only
menuconfig SND_SOC_REALTEK
	tristate "Realtek ALSA ASoC Driver"
	---help---
	  Say Y or M if you want to add support for codecs attached to
	  the Realtek SoCs' Audio interfaces. You will also need to
	  select the audio interfaces to support below.

if SND_SOC_REALTEK

config SND_SOC_SPORT_RTK_AMEBA
	tristate "Realtek Ameba Sport interface support"


config SND_SOC_DMA_RTK_AMEBA
        tristate "Realtek Ameba DMA interface support"

config SND_SOC_RTK_AMEBA
	tristate "Realtek Ameba Total Audio Support"
	select SND_SOC_CODEC_RTK_AMEBA
	select SND_SOC_SPORT_RTK_AMEBA
	select SND_SOC_DMA_RTK_AMEBA
	help
	Say Y if you want to add support for SoC audio on the AMEBA.



endif
```
