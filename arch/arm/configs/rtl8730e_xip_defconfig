## arch/arm/mach-amebasmart/Kconfig
```kconfig
#
# Realtek Semiconductor Corp.
#

# TODO: deprecate the configs from config.top

# SPDX-License-Identifier: GPL-2.0-only

# Cortex-A7
config SOC_CPU_ARMA7
    bool

config SOC_CPU_ARMA32
    bool
    default y

menuconfig ARCH_AMEBASMART
	bool "AmebaSmart ARM platform"
	select CPU_V8
	select ARM_GIC
	select ARM_GIC_V3
	select HAVE_ARM_ARCH_TIMER
	select CPU_LITTLE_ENDIAN
	select COMMON_CLK
	select GENERIC_IRQ_MULTI_HANDLER
	select CLKDEV_LOOKUP
	select GENERIC_CLOCKEVENTS
	select ARCH_HAS_CPUFREQ
	select HW_HAS_PCI
	select HW_HAS_USB
	select HAVE_ARM_SCU
	select HAVE_SMP
	select SMP
	select VFP
	select NEON
	select USE_OF
	select CPU_HAS_L2C
```

## drivers/rtkdrivers/Kconfig
```kconfig
# SPDX-License-Identifier: GPL-2.0
menuconfig RTK_DRIVERS
    tristate "Drivers for Realtek"
    default y

if RTK_DRIVERS

if NETDEVICES
if CFG80211
source "drivers/rtkdrivers/net/wireless/whc_host_linux/Kconfig"
endif
endif

source "drivers/rtkdrivers/adc/Kconfig"

source "drivers/rtkdrivers/captouch/Kconfig"

source "drivers/rtkdrivers/clocksource/Kconfig"

source "drivers/rtkdrivers/cpufreq/Kconfig"

source "drivers/rtkdrivers/crypto/Kconfig"

source "drivers/rtkdrivers/dma/Kconfig"

source "drivers/rtkdrivers/drm/Kconfig"

source "drivers/rtkdrivers/gpio/Kconfig"

source "drivers/rtkdrivers/ipc/Kconfig"

source "drivers/rtkdrivers/ir/Kconfig"

source "drivers/rtkdrivers/i2c/Kconfig"

source "drivers/rtkdrivers/km4_console/Kconfig"

source "drivers/rtkdrivers/ledc/Kconfig"

source "drivers/rtkdrivers/misc/Kconfig"

source "drivers/rtkdrivers/mrdump/Kconfig"

source "drivers/rtkdrivers/otp/Kconfig"

source "drivers/rtkdrivers/otp_ipc/Kconfig"

source "drivers/rtkdrivers/pinctrl/Kconfig"

source "drivers/rtkdrivers/pwm/Kconfig"

source "drivers/rtkdrivers/clk/Kconfig"

source "drivers/rtkdrivers/rtc/Kconfig"

source "drivers/rtkdrivers/spic/Kconfig"

source "drivers/rtkdrivers/mmc/Kconfig"

source "drivers/rtkdrivers/spi/Kconfig"

source "drivers/rtkdrivers/thermal/Kconfig"

source "drivers/rtkdrivers/touchscreen/Kconfig"

source "drivers/rtkdrivers/mfd_timer/Kconfig"

source "drivers/rtkdrivers/tty_serial/Kconfig"

source "drivers/rtkdrivers/usb_phy/Kconfig"

source "drivers/rtkdrivers/watchdog/Kconfig"

source "drivers/rtkdrivers/bluetooth/Kconfig"

source "drivers/rtkdrivers/audio_pll/Kconfig"

source "drivers/rtkdrivers/hw_random/Kconfig"

endif
```

## drivers/rtkdrivers/audio_pll/Kconfig
```kconfig
config AUDIO_PLL_RTK_AMEBA
	tristate "audio pll driver"
	help
		This enables the driver for the onchip audio pll for Ameba SoCs
```

## drivers/rtkdrivers/hw_random/Kconfig
```kconfig
config HW_RANDOM_RTK_AMEBA
	tristate "HW Random driver"
	select HW_RANDOM
	help
	  Enable this option to add support for Realtek hardware RNG driver embedded in Ameba SoCs.
```

## drivers/rtkdrivers/spic/Kconfig
```kconfig
# SPDX-License-Identifier: GPL-2.0-only
#
# SPIC driver configuration
#

config SPIC_RTK_AMEBA_RXI312
	bool "RXI312 SPI controller driver for NAND and NOR"
	select SPI
	select SPI_REALTEK_RXI312
	default y
	help
	  This is the driver for the REALTEK RXI312 SPI controller for NAND and NOR.
```

## drivers/rtkdrivers/touchscreen/Kconfig
```kconfig
menuconfig TOUCHSCREEN_RTK_AMEBA
	tristate "I2C touchscreen"
	depends on I2C
	depends on GPIOLIB || COMPILE_TEST

if TOUCHSCREEN_RTK_AMEBA

config TOUCHSCREEN_GT9XX
	tristate "Goodix touchpanel GT9xx series"
	help
	  Say Y here if you have a Goodix GT9xx touchscreen
	  controller.

		If build module, say M.
		If unsure, say N.

config TOUCHSCREEN_CST328
	tristate "CST328"
	help
	  Say Y here if you have a CST328 touchscreen
	  controller.

		If build module, say M.
		If unsure, say N.

endif
```

## drivers/rtkdrivers/usb_phy/Kconfig
```kconfig
config USB_RTK_AMEBA_USB20PHY
	tristate "USB PHY driver"
	select USB_PHY
        help
          Support Realtek USB20PHY for Ameba SoCs
```
