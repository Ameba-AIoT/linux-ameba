// SPDX-License-Identifier: GPL-2.0-only
/*
* Realtek DTS for SPI test
*
* Copyright (C) 2023, Realtek Corporation. All rights reserved.
*/

/dts-v1/;

#include "rtl8730e.dtsi"
#include "rtl8730e-spi-nand-128m.dtsi"

/ {
	memory {
		device_type = "memory";
		// DRAM base address should be 1MB-aligned.
		reg = <0x60300000 0x7D00000>;  // 128MB -- exclude 3MB secure memory
	};
};

// Configure peripherals.
&spi0 {
	pinctrl-names = "default";
	pinctrl-0 = <&spi0_pins>;
	rtk,spi-slave-mode = <0>; // SPI master
	status = "okay";
};

&spi1 {
	pinctrl-names = "default";
	pinctrl-0 = <&spi1_pins>;
	rtk,spi-slave-mode = <1>; // SPI slave
	status = "okay";
};