// SPDX-License-Identifier: GPL-2.0-only
/*
* Realtek DTS for IR TX test
*
* Copyright (C) 2023, Realtek Corporation. All rights reserved.
*/

/dts-v1/;

#include "rtl8730e.dtsi"
#include "rtl8730e-spi-nand-128m.dtsi"

/ {
	memory {
		device_type = "memory";
		// DRAM base address should be 1MB-aligned.
		reg = <0x60300000 0x7D00000>;  // 128MB -- exclude 3MB secure memory
	};
};

// Configure peripherals.
&ir {
	pinctrl-names = "default";
	pinctrl-0 = <&ir_pins>;
	rtk,ir-receiver = <0>; // 0: tx only; 1: rx only.
	status = "okay";
};